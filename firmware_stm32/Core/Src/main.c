/* USER CODE BEGIN Header */
/**
  ******************************************************************************
  * @file           : main.c
  * @brief          : Main program body - Vehicle Traffic Monitoring System
  * @author         : Generated by STM32CubeMX + Custom Application Code
  ******************************************************************************
  * @attention
  *
  * Copyright (c) 2024 STMicroelectronics.
  * All rights reserved.
  *
  * This software is licensed under terms that can be found in the LICENSE file
  * in the root directory of this software component.
  * If no LICENSE file comes with this software, it is provided AS-IS.
  *
  ******************************************************************************
  */
/* USER CODE END Header */
/* Includes ------------------------------------------------------------------*/
#include "main.h"
#include "config.h"
#include "sensor_driver.h"
#include "sim800l_driver.h"
#include "vehicle_detection.h"
#include <string.h>
#include <stdio.h>

/* Private includes ----------------------------------------------------------*/
/* USER CODE BEGIN Includes */

/* USER CODE END Includes */

/* Private typedef -----------------------------------------------------------*/
/* USER CODE BEGIN PTD */

/* USER CODE END PTD */

/* Private define ------------------------------------------------------------*/
/* USER CODE BEGIN PD */

/* USER CODE END PD */

/* Private macro -------------------------------------------------------------*/
/* USER CODE BEGIN PM */

/* USER CODE END PM */

/* Private variables ---------------------------------------------------------*/
extern ADC_HandleTypeDef hadc1;
extern I2C_HandleTypeDef hi2c1;
extern RTC_HandleTypeDef hrtc;
extern SD_HandleTypeDef hsd;
extern TIM_HandleTypeDef htim2;
extern TIM_HandleTypeDef htim4;
extern UART_HandleTypeDef huart1;
extern UART_HandleTypeDef huart2;
extern IWDG_HandleTypeDef hiwdg;

/* USER CODE BEGIN PV */

// System state variables
static uint32_t system_tick = 0;
static uint32_t last_send_time = 0;
static uint8_t device_initialized = 0;

// Traffic statistics (use the built-in statistics from vehicle detection)
static uint16_t lane1_count = 0;
static uint16_t lane2_count = 0;

// Environmental data
static float temperature = 0.0f;
static float humidity = 0.0f;
static float battery_voltage = 0.0f;

// Serial console
static uint8_t console_rx_byte;

// SIM800L configuration
static SIM800L_Config_t sim800l_config = {
    .apn = DEFAULT_APN,
    .apn_user = DEFAULT_APN_USER,
    .apn_pass = DEFAULT_APN_PASS,
    .server_ip = DEFAULT_SERVER_IP,
    .server_port = DEFAULT_SERVER_PORT,
    .timeout_ms = SIM800L_RESPONSE_TIMEOUT
};

/* USER CODE END PV */

/* Private function prototypes -----------------------------------------------*/
void SystemClock_Config(void);
static void MX_GPIO_Init(void);
static void MX_ADC1_Init(void);
static void MX_I2C1_Init(void);
static void MX_RTC_Init(void);
static void MX_SDIO_SD_Init(void);
static void MX_TIM2_Init(void);
static void MX_TIM4_Init(void);
static void MX_USART1_UART_Init(void);
static void MX_USART2_UART_Init(void);
static void MX_IWDG_Init(void);
/* USER CODE BEGIN PFP */

static void Process_1ms_Tasks(void);
static void Process_10min_Tasks(void);
static void Read_Battery_Voltage(void);
static void Read_Temperature_Humidity(void);
static void Send_Data_To_Server(void);
static void Process_Console_Command(char *cmd);
static void Print_Console_Menu(void);

/* USER CODE END PFP */

/* Private user code ---------------------------------------------------------*/
/* USER CODE BEGIN 0 */

/**
  * @brief  Printf retarget for UART1 console
  */
int _write(int file, char *ptr, int len)
{
    HAL_UART_Transmit(&huart1, (uint8_t*)ptr, len, HAL_MAX_DELAY);
    return len;
}

/**
  * @brief  1ms periodic tasks
  */
static void Process_1ms_Tasks(void)
{
    system_tick++;

    // Process sensor readings
    Sensor_Process();

    // Process vehicle detection
    VehicleDetection_Process();
}

/**
  * @brief  10-minute periodic tasks
  */
static void Process_10min_Tasks(void)
{
    printf("\r\n[INFO] 10-minute interval reached. Preparing data transmission...\r\n");

    // Read environmental sensors
    Read_Temperature_Humidity();
    Read_Battery_Voltage();

    // Send data to server
    Send_Data_To_Server();

    // Reset statistics
    VehicleDetection_ResetInterval();
    lane1_count = 0;
    lane2_count = 0;

    last_send_time = system_tick;
}

/**
  * @brief  Read battery voltage via ADC
  */
static void Read_Battery_Voltage(void)
{
    uint32_t adc_value = 0;

    HAL_ADC_Start(&hadc1);
    if (HAL_ADC_PollForConversion(&hadc1, 100) == HAL_OK) {
        adc_value = HAL_ADC_GetValue(&hadc1);
        // Voltage divider: 12V -> 3.3V (R1=10k, R2=3.9k)
        // ADC 12-bit: 4095 = 3.3V
        // Actual voltage = (adc_value * 3.3 / 4095) * (10 + 3.9) / 3.9
        battery_voltage = (adc_value * 3.3f / 4095.0f) * 3.564f;
    }
    HAL_ADC_Stop(&hadc1);

    printf("[BATTERY] Voltage: %.2f V\r\n", battery_voltage);

    if (battery_voltage < 11.0f) {
        printf("[WARNING] Low battery voltage!\r\n");
    }
}

/**
  * @brief  Read temperature and humidity from DHT22 or SHT30
  */
static void Read_Temperature_Humidity(void)
{
    // TODO: Implement DHT22 or SHT30 reading based on hardware
    // For now, use dummy values
    temperature = 25.0f;
    humidity = 60.0f;

    printf("[SENSOR] Temperature: %.1f C, Humidity: %.1f %%\r\n", temperature, humidity);
}

/**
  * @brief  Send traffic data to server via SIM800L
  */
static void Send_Data_To_Server(void)
{
    char json_buffer[2048];
    int json_len = 0;

    // Get interval statistics
    const IntervalStats_t *stats = VehicleDetection_GetIntervalStats();

    const LaneStats_t *lane1 = &stats->lane[0];
    const LaneStats_t *lane2 = &stats->lane[1];

    // Build JSON payload
    json_len = snprintf(json_buffer, sizeof(json_buffer),
        "{"
        "\"device_id\":\"%s\","
        "\"timestamp\":%lu,"
        "\"lane1\":{"
            "\"total\":%u,"
            "\"class_x\":%u,\"class_a\":%u,\"class_b\":%u,"
            "\"class_c\":%u,\"class_d\":%u,\"class_e\":%u,"
            "\"avg_speed\":%u,"
            "\"occupancy\":%.2f"
        "},"
        "\"lane2\":{"
            "\"total\":%u,"
            "\"class_x\":%u,\"class_a\":%u,\"class_b\":%u,"
            "\"class_c\":%u,\"class_d\":%u,\"class_e\":%u,"
            "\"avg_speed\":%u,"
            "\"occupancy\":%.2f"
        "},"
        "\"environment\":{"
            "\"temperature\":%.1f,"
            "\"humidity\":%.1f,"
            "\"battery_voltage\":%.2f"
        "},"
        "\"status\":{"
            "\"sensor_status\":\"OK\","
            "\"uptime\":%lu"
        "}"
        "}",
        DEFAULT_DEVICE_ID,
        system_tick / 1000,
        lane1->total_vehicles,
        lane1->class_X.count, lane1->class_A.count, lane1->class_B.count,
        lane1->class_C.count, lane1->class_D.count, lane1->class_E.count,
        lane1->class_A.avg_speed,
        lane1->occupancy_rate,
        lane2->total_vehicles,
        lane2->class_X.count, lane2->class_A.count, lane2->class_B.count,
        lane2->class_C.count, lane2->class_D.count, lane2->class_E.count,
        lane2->class_A.avg_speed,
        lane2->occupancy_rate,
        temperature, humidity, battery_voltage,
        system_tick / 1000
    );

    printf("\r\n[DATA] JSON Payload (%d bytes):\r\n%s\r\n", json_len, json_buffer);

    // Send via SIM800L
    if (SIM800L_SendJSON(json_buffer) == HAL_OK) {
        printf("[SUCCESS] Data sent to server successfully!\r\n");
    } else {
        printf("[ERROR] Failed to send data to server!\r\n");
    }
}

/**
  * @brief  Process console command
  */
static void Process_Console_Command(char *cmd)
{
    if (strcmp(cmd, "help") == 0) {
        Print_Console_Menu();
    }
    else if (strcmp(cmd, "status") == 0) {
        printf("\r\n=== SYSTEM STATUS ===\r\n");
        printf("Device ID: %s\r\n", DEFAULT_DEVICE_ID);
        printf("Firmware: %s\r\n", FIRMWARE_VERSION);
        printf("Uptime: %lu seconds\r\n", system_tick / 1000);
        printf("Battery: %.2f V\r\n", battery_voltage);
        printf("Temperature: %.1f C\r\n", temperature);
        printf("Humidity: %.1f %%\r\n", humidity);
        printf("Lane 1 Count: %u vehicles\r\n", lane1_count);
        printf("Lane 2 Count: %u vehicles\r\n", lane2_count);
        printf("Next send: %lu seconds\r\n", (DATA_SEND_INTERVAL - (system_tick - last_send_time)) / 1000);
    }
    else if (strcmp(cmd, "calibrate") == 0) {
        printf("\r\n[INFO] Starting sensor calibration...\r\n");
        Sensor_Calibrate();
        printf("[SUCCESS] Calibration complete!\r\n");
    }
    else if (strcmp(cmd, "send") == 0) {
        printf("\r\n[INFO] Manual data transmission requested...\r\n");
        Process_10min_Tasks();
    }
    else if (strcmp(cmd, "reset") == 0) {
        printf("\r\n[INFO] System reset requested. Rebooting in 3 seconds...\r\n");
        HAL_Delay(3000);
        NVIC_SystemReset();
    }
    else {
        printf("\r\nUnknown command: '%s'. Type 'help' for available commands.\r\n", cmd);
    }
}

/**
  * @brief  Print console menu
  */
static void Print_Console_Menu(void)
{
    printf("\r\n");
    printf("========================================\r\n");
    printf("  Vehicle Traffic Monitoring System\r\n");
    printf("  Firmware v%s\r\n", FIRMWARE_VERSION);
    printf("========================================\r\n");
    printf("Available commands:\r\n");
    printf("  help       - Show this menu\r\n");
    printf("  status     - Show system status\r\n");
    printf("  calibrate  - Calibrate sensors\r\n");
    printf("  send       - Send data now (manual)\r\n");
    printf("  reset      - Reset system\r\n");
    printf("========================================\r\n\r\n");
}

/**
  * @brief  UART1 RX callback (console)
  */
void HAL_UART_RxCpltCallback(UART_HandleTypeDef *huart)
{
    static char cmd_buffer[64];
    static uint8_t cmd_index = 0;

    if (huart == &huart1) {
        // Echo character
        HAL_UART_Transmit(&huart1, &console_rx_byte, 1, 10);

        if (console_rx_byte == '\r' || console_rx_byte == '\n') {
            if (cmd_index > 0) {
                cmd_buffer[cmd_index] = '\0';
                printf("\r\n");
                Process_Console_Command(cmd_buffer);
                cmd_index = 0;
                printf("> ");
            }
        }
        else if (console_rx_byte == 8 || console_rx_byte == 127) { // Backspace
            if (cmd_index > 0) {
                cmd_index--;
                printf(" \b");
            }
        }
        else if (cmd_index < sizeof(cmd_buffer) - 1) {
            cmd_buffer[cmd_index++] = console_rx_byte;
        }

        // Re-enable RX interrupt
        HAL_UART_Receive_IT(&huart1, &console_rx_byte, 1);
    }
}

/**
  * @brief  TIM4 period elapsed callback (1ms tick)
  */
void HAL_TIM_PeriodElapsedCallback(TIM_HandleTypeDef *htim)
{
    if (htim == &htim4) {
        Process_1ms_Tasks();

        // Check for 10-minute interval
        if ((system_tick - last_send_time) >= DATA_SEND_INTERVAL) {
            Process_10min_Tasks();
        }
    }
}

/**
  * @brief  TIM2 Input Capture callback (sensor pulse)
  */
void HAL_TIM_IC_CaptureCallback(TIM_HandleTypeDef *htim)
{
    if (htim == &htim2) {
        Sensor_IC_Callback(htim);
    }
}

/**
  * @brief  Vehicle detected callback
  */
void VehicleDetection_Callback(const VehicleInfo_t *vehicle)
{
    const char *class_names[] = {"X", "A", "B", "C", "D", "E", "?"};
    const char *dir_names[] = {"UNKNOWN", "UNKNOWN", "UNKNOWN", "UNKNOWN", "UNKNOWN",
                               "UNKNOWN", "UNKNOWN", "UNKNOWN", "UNKNOWN", "UNKNOWN",
                               "UNKNOWN", "UNKNOWN", "FORWARD", "UNKNOWN", "UNKNOWN",
                               "UNKNOWN", "UNKNOWN", "UNKNOWN", "UNKNOWN", "UNKNOWN",
                               "UNKNOWN", "REVERSE"};

    // Map class enum to index
    uint8_t class_idx = 6; // Unknown
    if (vehicle->class == 'X') class_idx = 0;
    else if (vehicle->class == 'A') class_idx = 1;
    else if (vehicle->class == 'B') class_idx = 2;
    else if (vehicle->class == 'C') class_idx = 3;
    else if (vehicle->class == 'D') class_idx = 4;
    else if (vehicle->class == 'E') class_idx = 5;

    printf("[VEHICLE] Lane %u: Class %s, Speed %u km/h, Length %u cm, Dir %s\r\n",
           vehicle->lane_id + 1,
           class_names[class_idx],
           vehicle->speed,
           vehicle->length,
           dir_names[vehicle->direction]);

    // Update counters
    if (vehicle->lane_id == 0) {
        lane1_count++;
    } else if (vehicle->lane_id == 1) {
        lane2_count++;
    }

    // Check for violations
    if (vehicle->speed_violation) {
        printf("[WARNING] Speed violation detected!\r\n");
    }
    if (vehicle->wrong_direction) {
        printf("[WARNING] Wrong direction detected!\r\n");
    }
    if (vehicle->short_headway) {
        printf("[WARNING] Short headway detected!\r\n");
    }
}

/* USER CODE END 0 */

/**
  * @brief  The application entry point.
  * @retval int
  */
int main(void)
{
  /* USER CODE BEGIN 1 */

  /* USER CODE END 1 */

  /* MCU Configuration--------------------------------------------------------*/

  /* Reset of all peripherals, Initializes the Flash interface and the Systick. */
  HAL_Init();

  /* USER CODE BEGIN Init */

  /* USER CODE END Init */

  /* Configure the system clock */
  SystemClock_Config();

  /* USER CODE BEGIN SysInit */

  /* USER CODE END SysInit */

  /* Initialize all configured peripherals */
  MX_GPIO_Init();
  MX_ADC1_Init();
  MX_I2C1_Init();
  MX_RTC_Init();
  MX_SDIO_SD_Init();
  MX_TIM2_Init();
  MX_TIM4_Init();
  MX_USART1_UART_Init();
  MX_USART2_UART_Init();
  /* USER CODE BEGIN 2 */

  // Print startup message
  printf("\r\n\r\n");
  printf("========================================\r\n");
  printf("  Vehicle Traffic Monitoring System\r\n");
  printf("  STM32F407VGT6 - Firmware v%s\r\n", FIRMWARE_VERSION);
  printf("  Device ID: %s\r\n", DEFAULT_DEVICE_ID);
  printf("========================================\r\n\r\n");

  // Initialize custom drivers
  printf("[INIT] Initializing sensor driver...\r\n");
  if (Sensor_Init(&htim2) != HAL_OK) {
      printf("[ERROR] Sensor initialization failed!\r\n");
  } else {
      printf("[OK] Sensor driver initialized\r\n");
  }

  printf("[INIT] Initializing SIM800L module...\r\n");
  if (SIM800L_Init(&huart2, &sim800l_config) != HAL_OK) {
      printf("[ERROR] SIM800L initialization failed!\r\n");
  } else {
      printf("[OK] SIM800L module initialized\r\n");
  }

  printf("[INIT] Initializing vehicle detection...\r\n");
  if (VehicleDetection_Init() != HAL_OK) {
      printf("[ERROR] Vehicle detection initialization failed!\r\n");
  } else {
      printf("[OK] Vehicle detection initialized\r\n");
  }

  // Initialize watchdog after time-consuming initialization
  MX_IWDG_Init();

  // Start timers
  HAL_TIM_Base_Start_IT(&htim4);  // 1ms tick timer
  HAL_TIM_IC_Start_IT(&htim2, TIM_CHANNEL_1);  // Input capture for sensors

  // Start UART receive
  HAL_UART_Receive_IT(&huart1, &console_rx_byte, 1);

  printf("\r\n[READY] System initialized successfully!\r\n");
  printf("Type 'help' for available commands.\r\n");
  printf("> ");

  device_initialized = 1;
  last_send_time = system_tick;

  /* USER CODE END 2 */

  /* Infinite loop */
  /* USER CODE BEGIN WHILE */
  while (1)
  {
    /* USER CODE END WHILE */

    /* USER CODE BEGIN 3 */

      // Refresh watchdog
      HAL_IWDG_Refresh(&hiwdg);

      // Main loop can be used for non-time-critical tasks
      // Most processing happens in interrupt callbacks

      HAL_Delay(100);
  }
  /* USER CODE END 3 */
}

/**
  * @brief System Clock Configuration
  * @retval None
  */
void SystemClock_Config(void)
{
  RCC_OscInitTypeDef RCC_OscInitStruct = {0};
  RCC_ClkInitTypeDef RCC_ClkInitStruct = {0};

  /** Configure the main internal regulator output voltage
  */
  __HAL_RCC_PWR_CLK_ENABLE();
  __HAL_PWR_VOLTAGESCALING_CONFIG(PWR_REGULATOR_VOLTAGE_SCALE1);

  /** Initializes the RCC Oscillators according to the specified parameters
  * in the RCC_OscInitTypeDef structure.
  */
  RCC_OscInitStruct.OscillatorType = RCC_OSCILLATORTYPE_LSI|RCC_OSCILLATORTYPE_HSE
                              |RCC_OSCILLATORTYPE_LSE;
  RCC_OscInitStruct.HSEState = RCC_HSE_ON;
  RCC_OscInitStruct.LSEState = RCC_LSE_ON;
  RCC_OscInitStruct.LSIState = RCC_LSI_ON;
  RCC_OscInitStruct.PLL.PLLState = RCC_PLL_ON;
  RCC_OscInitStruct.PLL.PLLSource = RCC_PLLSOURCE_HSE;
  RCC_OscInitStruct.PLL.PLLM = 25;
  RCC_OscInitStruct.PLL.PLLN = 336;
  RCC_OscInitStruct.PLL.PLLP = RCC_PLLP_DIV2;
  RCC_OscInitStruct.PLL.PLLQ = 7;
  if (HAL_RCC_OscConfig(&RCC_OscInitStruct) != HAL_OK)
  {
    Error_Handler();
  }

  /** Initializes the CPU, AHB and APB buses clocks
  */
  RCC_ClkInitStruct.ClockType = RCC_CLOCKTYPE_HCLK|RCC_CLOCKTYPE_SYSCLK
                              |RCC_CLOCKTYPE_PCLK1|RCC_CLOCKTYPE_PCLK2;
  RCC_ClkInitStruct.SYSCLKSource = RCC_SYSCLKSOURCE_PLLCLK;
  RCC_ClkInitStruct.AHBCLKDivider = RCC_SYSCLK_DIV1;
  RCC_ClkInitStruct.APB1CLKDivider = RCC_HCLK_DIV4;
  RCC_ClkInitStruct.APB2CLKDivider = RCC_HCLK_DIV2;

  if (HAL_RCC_ClockConfig(&RCC_ClkInitStruct, FLASH_LATENCY_5) != HAL_OK)
  {
    Error_Handler();
  }
}

/**
  * @brief ADC1 Initialization Function
  * @param None
  * @retval None
  */
static void MX_ADC1_Init(void)
{

  /* USER CODE BEGIN ADC1_Init 0 */

  /* USER CODE END ADC1_Init 0 */

  ADC_ChannelConfTypeDef sConfig = {0};

  /* USER CODE BEGIN ADC1_Init 1 */

  /* USER CODE END ADC1_Init 1 */

  /** Configure the global features of the ADC (Clock, Resolution, Data Alignment and number of conversion)
  */
  hadc1.Instance = ADC1;
  hadc1.Init.ClockPrescaler = ADC_CLOCK_SYNC_PCLK_DIV4;
  hadc1.Init.Resolution = ADC_RESOLUTION_12B;
  hadc1.Init.ScanConvMode = DISABLE;
  hadc1.Init.ContinuousConvMode = DISABLE;
  hadc1.Init.DiscontinuousConvMode = DISABLE;
  hadc1.Init.ExternalTrigConvEdge = ADC_EXTERNALTRIGCONVEDGE_NONE;
  hadc1.Init.ExternalTrigConv = ADC_SOFTWARE_START;
  hadc1.Init.DataAlign = ADC_DATAALIGN_RIGHT;
  hadc1.Init.NbrOfConversion = 1;
  hadc1.Init.DMAContinuousRequests = DISABLE;
  hadc1.Init.EOCSelection = ADC_EOC_SINGLE_CONV;
  if (HAL_ADC_Init(&hadc1) != HAL_OK)
  {
    Error_Handler();
  }

  /** Configure for the selected ADC regular channel its corresponding rank in the sequencer and its sample time.
  */
  sConfig.Channel = ADC_CHANNEL_4;
  sConfig.Rank = 1;
  sConfig.SamplingTime = ADC_SAMPLETIME_3CYCLES;
  if (HAL_ADC_ConfigChannel(&hadc1, &sConfig) != HAL_OK)
  {
    Error_Handler();
  }
  /* USER CODE BEGIN ADC1_Init 2 */

  /* USER CODE END ADC1_Init 2 */

}

/**
  * @brief I2C1 Initialization Function
  * @param None
  * @retval None
  */
static void MX_I2C1_Init(void)
{

  /* USER CODE BEGIN I2C1_Init 0 */

  /* USER CODE END I2C1_Init 0 */

  /* USER CODE BEGIN I2C1_Init 1 */

  /* USER CODE END I2C1_Init 1 */
  hi2c1.Instance = I2C1;
  hi2c1.Init.ClockSpeed = 100000;
  hi2c1.Init.DutyCycle = I2C_DUTYCYCLE_2;
  hi2c1.Init.OwnAddress1 = 0;
  hi2c1.Init.AddressingMode = I2C_ADDRESSINGMODE_7BIT;
  hi2c1.Init.DualAddressMode = I2C_DUALADDRESS_DISABLE;
  hi2c1.Init.OwnAddress2 = 0;
  hi2c1.Init.GeneralCallMode = I2C_GENERALCALL_DISABLE;
  hi2c1.Init.NoStretchMode = I2C_NOSTRETCH_DISABLE;
  if (HAL_I2C_Init(&hi2c1) != HAL_OK)
  {
    Error_Handler();
  }
  /* USER CODE BEGIN I2C1_Init 2 */

  /* USER CODE END I2C1_Init 2 */

}

/**
  * @brief RTC Initialization Function
  * @param None
  * @retval None
  */
static void MX_RTC_Init(void)
{

  /* USER CODE BEGIN RTC_Init 0 */

  /* USER CODE END RTC_Init 0 */

  /* USER CODE BEGIN RTC_Init 1 */

  /* USER CODE END RTC_Init 1 */

  /** Initialize RTC Only
  */
  hrtc.Instance = RTC;
  hrtc.Init.HourFormat = RTC_HOURFORMAT_24;
  hrtc.Init.AsynchPrediv = 127;
  hrtc.Init.SynchPrediv = 255;
  hrtc.Init.OutPut = RTC_OUTPUT_DISABLE;
  hrtc.Init.OutPutPolarity = RTC_OUTPUT_POLARITY_HIGH;
  hrtc.Init.OutPutType = RTC_OUTPUT_TYPE_OPENDRAIN;
  if (HAL_RTC_Init(&hrtc) != HAL_OK)
  {
    Error_Handler();
  }
  /* USER CODE BEGIN RTC_Init 2 */

  /* USER CODE END RTC_Init 2 */

}

/**
  * @brief SDIO Initialization Function
  * @param None
  * @retval None
  */
static void MX_SDIO_SD_Init(void)
{

  /* USER CODE BEGIN SDIO_Init 0 */

  /* USER CODE END SDIO_Init 0 */

  /* USER CODE BEGIN SDIO_Init 1 */

  /* USER CODE END SDIO_Init 1 */
  hsd.Instance = SDIO;
  hsd.Init.ClockEdge = SDIO_CLOCK_EDGE_RISING;
  hsd.Init.ClockBypass = SDIO_CLOCK_BYPASS_DISABLE;
  hsd.Init.ClockPowerSave = SDIO_CLOCK_POWER_SAVE_DISABLE;
  hsd.Init.BusWide = SDIO_BUS_WIDE_1B;
  hsd.Init.HardwareFlowControl = SDIO_HARDWARE_FLOW_CONTROL_DISABLE;
  hsd.Init.ClockDiv = 0;
  /* USER CODE BEGIN SDIO_Init 2 */

  /* USER CODE END SDIO_Init 2 */

}

/**
  * @brief TIM2 Initialization Function
  * @param None
  * @retval None
  */
static void MX_TIM2_Init(void)
{

  /* USER CODE BEGIN TIM2_Init 0 */

  /* USER CODE END TIM2_Init 0 */

  TIM_ClockConfigTypeDef sClockSourceConfig = {0};
  TIM_MasterConfigTypeDef sMasterConfig = {0};
  TIM_IC_InitTypeDef sConfigIC = {0};

  /* USER CODE BEGIN TIM2_Init 1 */

  /* USER CODE END TIM2_Init 1 */
  htim2.Instance = TIM2;
  htim2.Init.Prescaler = 84-1;
  htim2.Init.CounterMode = TIM_COUNTERMODE_UP;
  htim2.Init.Period = 65535;
  htim2.Init.ClockDivision = TIM_CLOCKDIVISION_DIV1;
  htim2.Init.AutoReloadPreload = TIM_AUTORELOAD_PRELOAD_DISABLE;
  if (HAL_TIM_Base_Init(&htim2) != HAL_OK)
  {
    Error_Handler();
  }
  sClockSourceConfig.ClockSource = TIM_CLOCKSOURCE_INTERNAL;
  if (HAL_TIM_ConfigClockSource(&htim2, &sClockSourceConfig) != HAL_OK)
  {
    Error_Handler();
  }
  if (HAL_TIM_IC_Init(&htim2) != HAL_OK)
  {
    Error_Handler();
  }
  sMasterConfig.MasterOutputTrigger = TIM_TRGO_RESET;
  sMasterConfig.MasterSlaveMode = TIM_MASTERSLAVEMODE_DISABLE;
  if (HAL_TIMEx_MasterConfigSynchronization(&htim2, &sMasterConfig) != HAL_OK)
  {
    Error_Handler();
  }
  sConfigIC.ICPolarity = TIM_INPUTCHANNELPOLARITY_RISING;
  sConfigIC.ICSelection = TIM_ICSELECTION_DIRECTTI;
  sConfigIC.ICPrescaler = TIM_ICPSC_DIV1;
  sConfigIC.ICFilter = 0;
  if (HAL_TIM_IC_ConfigChannel(&htim2, &sConfigIC, TIM_CHANNEL_1) != HAL_OK)
  {
    Error_Handler();
  }
  /* USER CODE BEGIN TIM2_Init 2 */

  /* USER CODE END TIM2_Init 2 */

}

/**
  * @brief TIM4 Initialization Function
  * @param None
  * @retval None
  */
static void MX_TIM4_Init(void)
{

  /* USER CODE BEGIN TIM4_Init 0 */

  /* USER CODE END TIM4_Init 0 */

  TIM_ClockConfigTypeDef sClockSourceConfig = {0};
  TIM_MasterConfigTypeDef sMasterConfig = {0};

  /* USER CODE BEGIN TIM4_Init 1 */

  /* USER CODE END TIM4_Init 1 */
  htim4.Instance = TIM4;
  htim4.Init.Prescaler = 84-1;
  htim4.Init.CounterMode = TIM_COUNTERMODE_UP;
  htim4.Init.Period = 1000-1;
  htim4.Init.ClockDivision = TIM_CLOCKDIVISION_DIV1;
  htim4.Init.AutoReloadPreload = TIM_AUTORELOAD_PRELOAD_DISABLE;
  if (HAL_TIM_Base_Init(&htim4) != HAL_OK)
  {
    Error_Handler();
  }
  sClockSourceConfig.ClockSource = TIM_CLOCKSOURCE_INTERNAL;
  if (HAL_TIM_ConfigClockSource(&htim4, &sClockSourceConfig) != HAL_OK)
  {
    Error_Handler();
  }
  sMasterConfig.MasterOutputTrigger = TIM_TRGO_RESET;
  sMasterConfig.MasterSlaveMode = TIM_MASTERSLAVEMODE_DISABLE;
  if (HAL_TIMEx_MasterConfigSynchronization(&htim4, &sMasterConfig) != HAL_OK)
  {
    Error_Handler();
  }
  /* USER CODE BEGIN TIM4_Init 2 */

  /* USER CODE END TIM4_Init 2 */

}

/**
  * @brief USART1 Initialization Function
  * @param None
  * @retval None
  */
static void MX_USART1_UART_Init(void)
{

  /* USER CODE BEGIN USART1_Init 0 */

  /* USER CODE END USART1_Init 0 */

  /* USER CODE BEGIN USART1_Init 1 */

  /* USER CODE END USART1_Init 1 */
  huart1.Instance = USART1;
  huart1.Init.BaudRate = 115200;
  huart1.Init.WordLength = UART_WORDLENGTH_8B;
  huart1.Init.StopBits = UART_STOPBITS_1;
  huart1.Init.Parity = UART_PARITY_NONE;
  huart1.Init.Mode = UART_MODE_TX_RX;
  huart1.Init.HwFlowCtl = UART_HWCONTROL_NONE;
  huart1.Init.OverSampling = UART_OVERSAMPLING_16;
  if (HAL_UART_Init(&huart1) != HAL_OK)
  {
    Error_Handler();
  }
  /* USER CODE BEGIN USART1_Init 2 */

  /* USER CODE END USART1_Init 2 */

}

/**
  * @brief USART2 Initialization Function
  * @param None
  * @retval None
  */
static void MX_USART2_UART_Init(void)
{

  /* USER CODE BEGIN USART2_Init 0 */

  /* USER CODE END USART2_Init 0 */

  /* USER CODE BEGIN USART2_Init 1 */

  /* USER CODE END USART2_Init 1 */
  huart2.Instance = USART2;
  huart2.Init.BaudRate = 115200;
  huart2.Init.WordLength = UART_WORDLENGTH_8B;
  huart2.Init.StopBits = UART_STOPBITS_1;
  huart2.Init.Parity = UART_PARITY_NONE;
  huart2.Init.Mode = UART_MODE_TX_RX;
  huart2.Init.HwFlowCtl = UART_HWCONTROL_NONE;
  huart2.Init.OverSampling = UART_OVERSAMPLING_16;
  if (HAL_UART_Init(&huart2) != HAL_OK)
  {
    Error_Handler();
  }
  /* USER CODE BEGIN USART2_Init 2 */

  /* USER CODE END USART2_Init 2 */

}

/**
  * @brief IWDG Initialization Function
  * @param None
  * @retval None
  */
static void MX_IWDG_Init(void)
{

  /* USER CODE BEGIN IWDG_Init 0 */

  /* USER CODE END IWDG_Init 0 */

  /* USER CODE BEGIN IWDG_Init 1 */

  /* USER CODE END IWDG_Init 1 */
  hiwdg.Instance = IWDG;
  hiwdg.Init.Prescaler = IWDG_PRESCALER_64;
  hiwdg.Init.Reload = 5000;
  if (HAL_IWDG_Init(&hiwdg) != HAL_OK)
  {
    Error_Handler();
  }
  /* USER CODE BEGIN IWDG_Init 2 */

  /* USER CODE END IWDG_Init 2 */

}

/**
  * @brief GPIO Initialization Function
  * @param None
  * @retval None
  */
static void MX_GPIO_Init(void)
{
  GPIO_InitTypeDef GPIO_InitStruct = {0};
/* USER CODE BEGIN MX_GPIO_Init_1 */
/* USER CODE END MX_GPIO_Init_1 */

  /* GPIO Ports Clock Enable */
  __HAL_RCC_GPIOH_CLK_ENABLE();
  __HAL_RCC_GPIOC_CLK_ENABLE();
  __HAL_RCC_GPIOA_CLK_ENABLE();
  __HAL_RCC_GPIOB_CLK_ENABLE();
  __HAL_RCC_GPIOD_CLK_ENABLE();

  /*Configure GPIO pin Output Level */
  HAL_GPIO_WritePin(GPIOD, GPIO_PIN_0|GPIO_PIN_1, GPIO_PIN_RESET);

  /*Configure GPIO pin Output Level */
  HAL_GPIO_WritePin(GPIOB, GPIO_PIN_2|GPIO_PIN_6|GPIO_PIN_7, GPIO_PIN_RESET);

  /*Configure GPIO pins : PD0 PD1 */
  GPIO_InitStruct.Pin = GPIO_PIN_0|GPIO_PIN_1;
  GPIO_InitStruct.Mode = GPIO_MODE_OUTPUT_PP;
  GPIO_InitStruct.Pull = GPIO_NOPULL;
  GPIO_InitStruct.Speed = GPIO_SPEED_FREQ_LOW;
  HAL_GPIO_Init(GPIOD, &GPIO_InitStruct);

  /*Configure GPIO pins : PB2 PB6 PB7 */
  GPIO_InitStruct.Pin = GPIO_PIN_2|GPIO_PIN_6|GPIO_PIN_7;
  GPIO_InitStruct.Mode = GPIO_MODE_OUTPUT_PP;
  GPIO_InitStruct.Pull = GPIO_NOPULL;
  GPIO_InitStruct.Speed = GPIO_SPEED_FREQ_LOW;
  HAL_GPIO_Init(GPIOB, &GPIO_InitStruct);

/* USER CODE BEGIN MX_GPIO_Init_2 */
/* USER CODE END MX_GPIO_Init_2 */
}

/* USER CODE BEGIN 4 */

/* USER CODE END 4 */

/**
  * @brief  This function is executed in case of error occurrence.
  * @retval None
  */
void Error_Handler(void)
{
  /* USER CODE BEGIN Error_Handler_Debug */
  /* User can add his own implementation to report the HAL error return state */
  __disable_irq();
  while (1)
  {
  }
  /* USER CODE END Error_Handler_Debug */
}

#ifdef  USE_FULL_ASSERT
/**
  * @brief  Reports the name of the source file and the source line number
  *         where the assert_param error has occurred.
  * @param  file: pointer to the source file name
  * @param  line: assert_param error line source number
  * @retval None
  */
void assert_failed(uint8_t *file, uint32_t line)
{
  /* USER CODE BEGIN 6 */
  /* User can add his own implementation to report the file name and line number,
     ex: printf("Wrong parameters value: file %s on line %d\r\n", file, line) */
  /* USER CODE END 6 */
}
#endif /* USE_FULL_ASSERT */
